## config/boards/shields/numpad/Kconfig.defconfig
```kconfig
if SHIELD_NUMPAD

config ZMK_KEYBOARD_NAME
	default "Numpad"
	
endif

CONFIG_ZMK_RGB_UNDERGLOW=y
CONFIG_WS2812_STRIP=y
CONFIG_ZMK_RGB_UNDERGLOW_BRT_START=50
```
